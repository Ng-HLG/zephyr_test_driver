## CMakeLists.txt
```
# SPDX-License-Identifier: Apache-2.0
cmake_minimum_required(VERSION 3.20.0)

list(APPEND ZEPHYR_EXTRA_MODULES
  ${CMAKE_CURRENT_SOURCE_DIR}/drivers
)

find_package(Zephyr REQUIRED HINTS $ENV{ZEPHYR_BASE})
project(test_driver)

target_sources(app PRIVATE src/main.c)

list(APPEND SYSCALL_INCLUDE_DIRS ${CMAKE_CURRENT_SOURCE_DIR}/include)
zephyr_include_directories(include)
```

## sample.yaml
```
sample:
  name: Test Driver
```

## prj.conf
```kconfig
CONFIG_I2C=y
CONFIG_I2C_NIOS2=y
CONFIG_MY_I2C_DRIVER=y
```

## boards/altera_max10.overlay
```dts
/{
	soc{
		i2c_custom: i2c@0 {
			compatible = "foo,i2c-driver";
			#address-cells = <1>;
			#size-cells = <0>;
			reg = <0 100>;
			status = "okay";
			label= "i2c_custom";
		};
	}; 
};
```

## dts/bindings/i2c/foo,i2c-driver.yaml
```yaml
# Copyright (c) 2022 Nordic Semiconductor ASA
# SPDX-License-Identifier: Apache-2.0

description: I2C Driver with Zephyr Semaphores

compatible: "foo,i2c-driver"

include: i2c-controller.yaml

properties:
    reg:
      required: true

    interrupts:
      required: false
```

## src/main.c
```c
/*
 * Copyright (c) 2016 Intel Corporation
 *
 * SPDX-License-Identifier: Apache-2.0
 */

#include <zephyr.h>
#include <device.h>
#include <devicetree.h>

#define I2C_TEST DT_PATH(soc, i2c_0)
void main(void)
{
	// I2C Device Init
	const struct device *i2c_dev = DEVICE_DT_GET(I2C_TEST);
	if(device_is_ready(i2c_dev))
		printf("success");
	else
		printf("fail");

	while (1) {}
}
```
